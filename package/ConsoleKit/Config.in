## package/ConsoleKit/Config.in
```kconfig
config BR2_PACKAGE_CONSOLEKIT
    bool "consolekit"
    select BR2_PACKAGE_DBUS
    select BR2_PACKAGE_DBUS_GLIB
    select BR2_PACKAGE_POLKIT
    help
      ConsoleKit is a framework for defining and tracking users, login sessions, and seats.

      http://www.freedesktop.org/wiki/Software/ConsoleKit
```

## package/bc/Config.in
```kconfig
config BR2_PACKAGE_BC
        bool "bc"
        help
          Bc is an arbitrary precision numeric processing language.
          Syntax is similar to C, but differs in many substantial areas.
          It supports interactive execution of statements. Bc is a utility included
          in the POSIX P1003.2/D11 draft standard. Since the POSIX document does not
          specify how bc must be implemented, this version does not use the historical
          method of having bc be a compiler for the dc calculator. This version has a
          single executable that both compiles the language and runs the resulting
          'byte code'. The byte code is not the dc language.

          http://www.gnu.org/software/bc/bc.html
```

## package/boost/Config.in
```kconfig
config BR2_PACKAGE_BOOST
        bool "boost"
        select BR2_PACKAGE_ZLIB
        select BR2_PACKAGE_BZIP2
        help
            Peer-reviewed STL style libraries for C++
            http://www.boost.org/
```

## package/configobj/Config.in
```kconfig
config BR2_PACKAGE_CONFIGOBJ
        bool "configobj"
        depends on BR2_PACKAGE_PYTHON
        select BR2_PACKAGE_DISTRIBUTE
        select BR2_PACKAGE_DISTUTILSCROSS
        help
          ConfigObj is a simple but powerful config file reader and writer:
          an ini file round tripper. Its main feature is that it is very easy
          to use, with a straightforward programmer's interface and a simple
          syntax for config files.

          http://www.voidspace.org.uk/python/configobj.html
```

## package/dbus-glib/Config.in
```kconfig
config BR2_PACKAGE_DBUS_GLIB
        depends on BR2_PACKAGE_DBUS
        depends on BR2_USE_WCHAR
        depends on BR2_PACKAGE_EXPAT
	bool "dbus-glib"
	select BR2_PACKAGE_LIBGLIB2
	help
	  GLib bindings for D-Bus.

	  http://www.freedesktop.org/software/dbus

comment "dbus-glib requires a toolchain with WCHAR support"
	depends on BR2_PACKAGE_DBUS && !BR2_USE_WCHAR
```

## package/distribute/Config.in
```kconfig
config BR2_PACKAGE_DISTRIBUTE
        bool "distribute"
        depends on BR2_PACKAGE_PYTHON
        help
          Distribute is intended to replace Setuptools as the standard method for working
          with Python module distributions. Packages built and distributed using distribute
          look to the user like ordinary Python packages based on the distutils.
          Your users don't need to install or even know about setuptools in order to use them,
          and you don't have to include the entire setuptools package in your distributions.
          By including just a single bootstrap module (a 7K .py file), your package will
          automatically download and install setuptools if the user is building your
          package from source and doesn't have a suitable version already installed.

          http://pypi.python.org/pypi/distribute
```

## package/distutilscross/Config.in
```kconfig
config BR2_PACKAGE_DISTUTILSCROSS
        bool "distutilscross"
        depends on BR2_PACKAGE_PYTHON
        select BR2_PACKAGE_DISTRIBUTE
        help
          distutilscross enhances distutils to support Cross Compile of Python extensions

          http://bitbucket.org/lambacck/distutilscross/
```

## package/eggdbus/Config.in
```kconfig
config BR2_PACKAGE_EGGDBUS
	bool "eggdbus"
        select BR2_PACKAGE_LIBGLIB2
        select BR2_PACKAGE_DBUS
        select BR2_PACKAGE_DBUS_GLIB
	help
          D-Bus bindings for GObject.

          http://cgit.freedesktop.org/~david/eggdbus
```

## package/enca/Config.in
```kconfig
config BR2_PACKAGE_ENCA
        bool "enca"
        select BR2_PACKAGE_LIBICONV if !BR2_ENABLE_LOCALE
        help
             detects the encoding of text files, on the basis of knowledge of their language.
             http://freshmeat.net/projects/enca/
```

## package/fftw/Config.in
```kconfig
config BR2_PACKAGE_FFTW
  bool "fftw"
  help
    FFTW is a C subroutine library for computing the discrete Fourier transform (DFT) in one or more dimensions

    http://www.fftw.org
```

## package/fontconfig/Config.in
```kconfig
config BR2_PACKAGE_FONTCONFIG
	bool "fontconfig"
	select BR2_PACKAGE_FREETYPE
	select BR2_PACKAGE_LIBXML2
        select BR2_PACKAGE_ZLIB
	help
	  a library for font customization and configuration.

	  http://www.fontconfig.org/
```

## package/freetype/Config.in
```kconfig
config BR2_PACKAGE_FREETYPE
	bool "freetype"
        select BR2_PACKAGE_ZLIB
	help
	  a free, high-quality and portable font engine.

	  http://www.freetype.org/
```

## package/fribidi/Config.in
```kconfig
config BR2_PACKAGE_FRIBIDI
        bool "fribidi"
        help
            The Bidirectional Algorithm library
            http://fribidi.org/
```

## package/glew/Config.in
```kconfig
config BR2_PACKAGE_GLEW
        bool "GLEW Library"
        select BR2_PACKAGE_XLIB_LIBX11
        select BR2_PACKAGE_XLIB_LIBXEXT
        select BR2_PACKAGE_XLIB_LIBXI
        select BR2_PACKAGE_XLIB_LIBXMU
        select BR2_PACKAGE_MESA3D
        help
            The OpenGL Extension Wrangler Library (GLEW) is a cross-platform C/C++ extension loading library.
            GLEW provides efficient run-time mechanisms for determining which OpenGL extensions are supported
            on the target platform. OpenGL core and extension functionality is exposed in a single header file.
```

## package/gnutls/Config.in
```kconfig
config BR2_PACKAGE_GNUTLS
	bool "gnutls"
        select BR2_PACKAGE_CRYPTODEV_LINUX
        select BR2_PACKAGE_ZLIB
        select BR2_PACKAGE_NETTLE
	help
	  GnuTLS is a secure communications library implementing the SSL
	  and TLS protocols and technologies around them.

	  http://www.gnu.org/software/gnutls/gnutls.html
```

## package/jasper/Config.in
```kconfig
config BR2_PACKAGE_JASPER
        bool "jasper"
        help
            JPEG-2000 Part-1 standard (i.e., ISO/IEC 15444-1) implementation.
            http://www.ece.uvic.ca/~mdadams/jasper/
```

## package/jfsutils/Config.in
```kconfig
config BR2_PACKAGE_JFSUTILS
	bool "jfsutils"
        select BR2_PACKAGE_UTIL_LINUX
	help
	    Journaled File System Technology for Linux 
	    http://jfs.sourceforge.net/
```

## package/jpeg/Config.in
```kconfig
config BR2_PACKAGE_JPEG_LIBRARY
        bool "Jpeg Library"
        help
            "Jpeg library"
if BR2_PACKAGE_JPEG_LIBRARY

choice
        prompt "Jpeg library to use"
        default BR2_PACKAGE_JPEG
config BR2_PACKAGE_JPEG
	bool "jpeg"
	help
	  The ubiquitous C library for manipulating JPEG images.

	  http://www.ijg.org/
source "package/libjpeg-turbo/Config.in"
endchoice
config BR2_JPEG_LIBRARY
        string
        default jpeg if BR2_PACKAGE_JPEG
        default libjpeg-turbo if BR2_PACKAGE_LIBJPEG_TURBO
endif
```

## package/kmod/Config.in
```kconfig
config BR2_PACKAGE_KMOD
	bool "kmod"
	help
	  The new module loader.

	  http://www.kernel.org/pub/linux/utils/kernel/kmod/
```

## package/libatasmart/Config.in
```kconfig
config BR2_PACKAGE_LIBATASMART
	bool "libatasmart"
        depends on BR2_PACKAGE_UDEV
	help
            libatasmart is a lean, small and clean implementation of an ATA S.M.A.R.T.
            reading and parsing library. It's fairly comprehensive, however I only support
            a subset of the full S.M.A.R.T. set of functions:
            those parts which made sense to me, not the esoteric stuff.

            http://0pointer.de/blog/projects/being-smart.html
```

## package/libc-gconv/Config.in
```kconfig
config BR2_PACKAGE_LIBC_GCONV
        bool "libc-gconv"
        help
            Gconv conversion modules from libc
```

## package/libc/Config.in
```kconfig
config BR2_PACKAGE_LIBC
	bool "libc"
	help
	    This package needed for build opkg package from toolchain libc library.
```

## package/libcurl/Config.in
```kconfig
config BR2_PACKAGE_LIBCURL
	bool "libcurl"
        select BR2_PACKAGE_RTMPDUMP
        select BR2_PACKAGE_ZLIB
        select BR2_PACKAGE_OPENSSL
	help
	  cURL is a tool for getting files from FTP, HTTP, Gopher, Telnet,
	  and Dict servers, using any of the supported protocols.

	  http://curl.haxx.nu/

config BR2_PACKAGE_CURL
	bool "curl binary"
	depends on BR2_PACKAGE_LIBCURL
	help
	  Install curl binary as well
```

## package/libgssglue/Config.in
```kconfig
config BR2_PACKAGE_LIBGSSGLUE
        bool "libgssglue"
        help
          libgssglue is a library which exports a gssapi interface,
          but doesn't implement any gssapi mechanisms itself;
          instead it calls gssapi routines in other libraries, depending on the mechanism.

          http://www.citi.umich.edu/projects/nfsv4/linux/libgssglue/
```

## package/libjpeg-turbo/Config.in
```kconfig
config BR2_PACKAGE_LIBJPEG_TURBO
        bool "libjpeg-turbo"
        help
            a high-speed version of libjpeg for x86 and x86-64
            processors which uses SIMD instructions (MMX, SSE2, etc.)
            to accelerate baseline JPEG compression and decompression.

            http://libjpeg-turbo.virtualgl.org/
```
