## package/nvram-wakeup/Config.in
```kconfig
config BR2_PACKAGE_NVRAM_WAKEUP
        bool "nvram-wakeup"
        help
            This is a small program that reads and writes the WakeUp time in the BIOS.

            http://sourceforge.net/projects/nvram-wakeup/
```

## package/opkg/Config.in
```kconfig
config BR2_PACKAGE_OPKG
        bool "opkg"
        select BR2_PACKAGE_LIBCURL
        select BR2_PACKAGE_OPENSSL
        help
            Opkg is a lightweight package management system based on Ipkg.

            http://code.google.com/p/opkg/
```

## package/oscam/Config.in
```kconfig
config BR2_PACKAGE_OSCAM
        bool "oscam"
        help
          OSCam is an Open Source Conditional Access Module software,
          based on the very good MpCS version 0.9d

          http://www.streamboard.tv/

config BR2_OSCAM_USE_DEFAULT_CONF
        bool "use default oscam configuration"
        depends on BR2_PACKAGE_OSCAM

config BR2_OSCAM_ADDONS
        string "OSCam addons"
        depends on !BR2_OSCAM_USE_DEFAULT_CONF && BR2_PACKAGE_OSCAM
        default "WEBIF TOUCH HAVE_DVBAPI IRDETO_GUESSING CS_ANTICASC WITH_DEBUG MODULE_MONITOR WITH_SSL WITH_LB CS_CACHEEX CW_CYCLE_CHECK LCDSUPPORT LEDSUPPORT IPV6SUPPORT"

config BR2_OSCAM_PROTOCOLS
        string "OSCam protocols"
        depends on !BR2_OSCAM_USE_DEFAULT_CONF && BR2_PACKAGE_OSCAM
        default "MODULE_CAMD33 MODULE_CAMD35 MODULE_CAMD35_TCP MODULE_NEWCAMD MODULE_CCCAM MODULE_CCCSHARE MODULE_GBOX MODULE_RADEGAST MODULE_SERIAL MODULE_CONSTCW MODULE_PANDORA MODULE_GHTTP"

config BR2_OSCAM_READERS
        string "OSCam readers"
        depends on !BR2_OSCAM_USE_DEFAULT_CONF && BR2_PACKAGE_OSCAM
        default "READER_NAGRA READER_IRDETO READER_CONAX READER_CRYPTOWORKS READER_SECA READER_VIACCESS READER_VIDEOGUARD READER_DRE READER_TONGFANG READER_BULCRYPT READER_GRIFFIN READER_DGCRYPT"

config BR2_OSCAM_CARD_READERS
        string "List of OSCam card readers"
        depends on !BR2_OSCAM_USE_DEFAULT_CONF && BR2_PACKAGE_OSCAM
        default "CARDREADER_PHOENIX CARDREADER_INTERNAL CARDREADER_SC8IN1 CARDREADER_MP35 CARDREADER_SMARGO CARDREADER_DB2COM CARDREADER_STAPI CARDREADER_STINGER"
```

## package/parted/Config.in
```kconfig
config BR2_PACKAGE_PARTED
	bool "parted"
        select BR2_PACKAGE_UTIL_LINUX
	help
          GNU Parted is a program for creating, destroying, resizing, checking and copying partitions,
          and the file systems on them. This is useful for creating space for new operating systems,
          reorganising disk usage, copying data between hard disks and disk imaging.

          http://www.gnu.org/software/parted/
```

## package/pixman/Config.in
```kconfig
config BR2_PACKAGE_PIXMAN
	bool "pixman"
        select BR2_PACKAGE_XUTIL_UTIL_MACROS
	help
	  Cairo pixel manager

	  http://cairographics.org/releases/
```

## package/pm-utils/Config.in
```kconfig
config BR2_PACKAGE_PM_UTILS
	bool "pm-utils"
	help
          pm-utils is a small collection of scripts that handle suspend and resume on behalf of HAL.

          http://pm-utils.freedesktop.org/wiki/
```

## package/polkit/Config.in
```kconfig
config BR2_PACKAGE_POLKIT
	bool "polkit"
        select BR2_PACKAGE_ZLIB
        select BR2_PACKAGE_SG3_UTILS
        select BR2_PACKAGE_LIBGLIB2
        select BR2_PACKAGE_UDEV
        select BR2_PACKAGE_EGGDBUS
        select BR2_PACKAGE_EXPAT
	help
          PolicyKit is a toolkit for defining and handling authorizations.
          It is used for allowing unprivileged processes to speak to privileged processes.
          
          http://gitweb.freedesktop.org/?p=PolicyKit.git;a=summary
```

## package/ratpoison/Config.in
```kconfig
config BR2_PACKAGE_RATPOISON
        bool "ratpoison"
        select BR2_PACKAGE_XLIB_LIBXFT
        select BR2_PACKAGE_XLIB_LIBICE
        select BR2_PACKAGE_XLIB_LIBX11
        select BR2_PACKAGE_XLIB_LIBXEXT
        select BR2_PACKAGE_XLIB_LIBXTST
        select BR2_PACKAGE_XLIB_LIBXINERAMA
        depends on BR2_PACKAGE_XSERVER_XORG_SERVER
        help
          Ratpoison is a simple window manager with no large library dependencies,
          no fancy graphics, no window decorations, and no rodent dependence.
          It is largely modeled after GNU Screen, which has done wonders in the
          virtual terminal market. All interaction with the window manager is done
          through keystrokes. Ratpoison has a prefix map to minimize the key
          clobbering that cripples EMACS and other quality pieces of software.
          All windows are maximized and kept maximized to avoid wasting precious
          screen space

          http://www.nongnu.org/ratpoison
```

## package/sg3_utils/Config.in
```kconfig
config BR2_PACKAGE_SG3_UTILS
	bool "sg3_utils"
	help
          sg3_utils is a package of utilities for accessing devices that use SCSI command sets.
          Most utilities issue a single command and display the response, while some work at a
          slightly higher level. There are utilities for fetching INQUIRY data and VPD, mode,
          and log pages. There is support for modern SCSI transports such as SAS and FCP.

          http://freshmeat.net/projects/sg3_utils/
```

## package/simplejson/Config.in
```kconfig
config BR2_PACKAGE_SIMPLEJSON
        bool "simplejson"
        depends on BR2_PACKAGE_PYTHON
        select BR2_PACKAGE_DISTRIBUTE
        help
          simplejson is a simple, fast, complete, correct and extensible JSON <http://json.org>
          encoder and decoder for Python 2.5+. It is pure Python code with no dependencies,
          but includes an optional C extension for a serious speed boost.

          http://pypi.python.org/pypi/simplejson
```

## package/swig/Config.in
```kconfig
config BR2_PACKAGE_SWIG
	bool "swig"
	help
          SWIG is a software development tool that connects programs written in C and C++ with a variety of high-level programming languages.

	  http://www.swig.org/
```

## package/timezone-data/Config.in
```kconfig
config BR2_PACKAGE_TIMEZONE_DATA
	bool "timezone-data"
	help
          timezone-data

          ftp://elsie.nci.nih.gov/pub/
```

## package/tinyxml/Config.in
```kconfig
config BR2_PACKAGE_TINYXML
	bool "tinyxml"
	help
	  TinyXML is a simple, small, minimal, C++ XML parser that can be easily
	  integrating into other programs. It reads XML and creates C++ objects
	  representing the XML document. The objects can be manipulated, changed,
	  and saved again as XML.
```

## package/transmission/Config.in
```kconfig
config BR2_PACKAGE_TRANSMISSION
  bool "transmission"
  select BR2_PACKAGE_ZLIB
  select BR2_PACKAGE_OPENSSL
  select BR2_PACKAGE_LIBCURL
  select BR2_PACKAGE_LIBEVENT
  help
      Transmission is a cross-platform BitTorrent client.
      
if BR2_PACKAGE_TRANSMISSION

config BR2_PACKAGE_TRANSMISSION_UTP
  bool "Transmission uTP support"
  depends on BR2_INSTALL_LIBSTDCPP
  help
      Install support for uTorrent Transport Protocol

comment "uTP requires a toolchain with C++ support"
  depends on !BR2_INSTALL_LIBSTDCPP
  
config BR2_PACKAGE_TRANSMISSION_CLI
  bool "transmission-cli"
  help
      Install transmission command line interface.
      
config BR2_PACKAGE_TRANSMISSION_DAEMON
  bool "transmission-daemon"
  help
      Install transmission daemon.
      
endif
```

## package/udisks/Config.in
```kconfig
config BR2_PACKAGE_UDISKS
	bool "udisks"
        select BR2_PACKAGE_SG3_UTILS
        select BR2_PACKAGE_UDEV
        select BR2_PACKAGE_LIBGLIB2
        select BR2_PACKAGE_DBUS
        select BR2_PACKAGE_DBUS_GLIB
        select BR2_PACKAGE_PARTED
        select BR2_PACKAGE_LVM2
        select BR2_PACKAGE_POLKIT
        select BR2_PACKAGE_LIBATASMART
	help
          Udisks is a modular hardware abstraction layer designed for use in Linux systems
          that is designed to simplify device management and replace the current monolithic Linux HAL.
          Udisks includes the ability to enumerate system devices and send notifications
          when hardware is added or removed from the computer system.

          http://www.freedesktop.org/wiki/Software/udisks
```

## package/upower/Config.in
```kconfig
config BR2_PACKAGE_UPOWER
	bool "upower"
        select BR2_PACKAGE_UDEV
        select BR2_PACKAGE_LIBGLIB2
        select BR2_PACKAGE_DBUS
        select BR2_PACKAGE_DBUS_GLIB
        select BR2_PACKAGE_GOBJECT_INTROSPECTION
        select BR2_PACKAGE_POLKIT
	help
          Upower is a modular hardware abstraction layer designed for use in Linux systems 
          that is designed to simplify device management and replace the current monolithic Linux HAL.
          Upower includes the ability to enumerate system devices and send notifications when
          hardware is added or removed from the computer system.

          http://upower.freedesktop.org/
```

## package/x11r7/xdriver_xf86-video-nvidia/Config.in
```kconfig
config BR2_PACKAGE_XDRIVER_XF86_VIDEO_NVIDIA
	bool "xf86-video-nvidia"
	select BR2_PACKAGE_XSERVER_XORG_SERVER
        select BR2_PACKAGE_XUTIL_UTIL_MACROS
	help
	  The Xorg driver for NVIDIA video chips
```

## package/x11r7/xfont_font-bitstream-type1/Config.in
```kconfig
config BR2_PACKAGE_XFONT_FONT_BITSTREAM_TYPE1
	bool "font-bitstream-type1"
        select BR2_PACKAGE_XUTIL_UTIL_MACROS
	help
	  No description available
```

## package/x11r7/xfont_font-cursor-misc/Config.in
```kconfig
config BR2_PACKAGE_XFONT_FONT_CURSOR_MISC
	bool "font-cursor-misc"
        select BR2_PACKAGE_XUTIL_UTIL_MACROS
	help
	  No description available
```

## package/x11r7/xfont_font-liberation-fonts-ttf/Config.in
```kconfig
config BR2_PACKAGE_XFONT_FONT_LIBERATION_FONTS_TTF
	bool "font-liberation-fonts-ttf"
	help
          This packages included the high-quality and open-sourced TrueType vector fonts released by RedHat.

          https://www.redhat.com/promo/fonts/
```

## package/x11r7/xfont_font-misc-misc/Config.in
```kconfig
config BR2_PACKAGE_XFONT_FONT_MISC_MISC
	bool "font-misc-misc"
        select BR2_PACKAGE_XUTIL_UTIL_MACROS
        select BR2_PACKAGE_XFONT_FONT_CURSOR_MISC
	help
	  No description available
```

## package/x11r7/xfont_font-util/Config.in
```kconfig
config BR2_PACKAGE_XFONT_FONT_UTIL
	bool "font-util"
        select BR2_PACKAGE_XUTIL_UTIL_MACROS
	help
	  No description available
```

## package/x11r7/xlib_libICE/Config.in
```kconfig
config BR2_PACKAGE_XLIB_LIBICE
	bool "libICE"
	select BR2_PACKAGE_XLIB_XTRANS
	select BR2_PACKAGE_XPROTO_XPROTO
        select BR2_PACKAGE_XUTIL_UTIL_MACROS
	help
	  X.Org ICE library
```

## package/x11r7/xlib_libSM/Config.in
```kconfig
config BR2_PACKAGE_XLIB_LIBSM
	bool "libSM"
	select BR2_PACKAGE_XLIB_LIBICE
        select BR2_PACKAGE_UTIL_LINUX
	help
	  X.Org SM library
```

## package/x11r7/xlib_libXdamage/Config.in
```kconfig
config BR2_PACKAGE_XLIB_LIBXDAMAGE
	bool "libXdamage"
	select BR2_PACKAGE_XPROTO_DAMAGEPROTO
	select BR2_PACKAGE_XLIB_LIBX11
	select BR2_PACKAGE_XLIB_LIBXFIXES
	select BR2_PACKAGE_XPROTO_XPROTO
        select BR2_PACKAGE_XUTIL_UTIL_MACROS
	help
	  X.Org Xdamage library
```
