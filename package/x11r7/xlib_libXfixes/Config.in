## package/x11r7/xlib_libXfixes/Config.in
```kconfig
config BR2_PACKAGE_XLIB_LIBXFIXES
	bool "libXfixes"
	select BR2_PACKAGE_XPROTO_FIXESPROTO
	select BR2_PACKAGE_XLIB_LIBX11
	help
	  X.Org Xfixes library
```

## package/x11r7/xlib_libXfont/Config.in
```kconfig
config BR2_PACKAGE_XLIB_LIBXFONT
	bool "libXfont"
        select BR2_PACKAGE_XUTIL_UTIL_MACROS
	select BR2_PACKAGE_XPROTO_FONTCACHEPROTO
	select BR2_PACKAGE_XPROTO_FONTSPROTO
	select BR2_PACKAGE_XLIB_XTRANS
	select BR2_PACKAGE_FREETYPE
	select BR2_PACKAGE_XLIB_LIBFONTENC
	help
	  X.Org Xfont library
```

## package/x11r7/xlib_libXinerama/Config.in
```kconfig
config BR2_PACKAGE_XLIB_LIBXINERAMA
	bool "libXinerama"
        select BR2_PACKAGE_XUTIL_UTIL_MACROS
	select BR2_PACKAGE_XLIB_LIBXEXT
	select BR2_PACKAGE_XPROTO_XINERAMAPROTO
	help
	  X.Org Xinerama library
```

## package/x11r7/xlib_libXmu/Config.in
```kconfig
config BR2_PACKAGE_XLIB_LIBXMU
	bool "libXmu"
	select BR2_PACKAGE_XLIB_LIBX11
	select BR2_PACKAGE_XLIB_LIBXEXT
	select BR2_PACKAGE_XLIB_LIBXT
	select BR2_PACKAGE_XPROTO_XPROTO
        select BR2_PACKAGE_XPROTO_XEXTPROTO
	help
	  X.Org Xmu library
```

## package/x11r7/xlib_libXt/Config.in
```kconfig
config BR2_PACKAGE_XLIB_LIBXT
	bool "libXt"
	select BR2_PACKAGE_XLIB_LIBSM
	select BR2_PACKAGE_XLIB_LIBX11
	help
	  X.Org Xt library
```

## package/x11r7/xlib_libXtst/Config.in
```kconfig
config BR2_PACKAGE_XLIB_LIBXTST
	bool "libXtst"
        select BR2_PACKAGE_XUTIL_UTIL_MACROS
	select BR2_PACKAGE_XPROTO_RECORDPROTO
	select BR2_PACKAGE_XLIB_LIBXEXT
	select BR2_PACKAGE_XLIB_LIBX11
	select BR2_PACKAGE_XLIB_LIBXI
	help
	  X.Org Xtst library
```

## package/x11r7/xlib_libXxf86vm/Config.in
```kconfig
config BR2_PACKAGE_XLIB_LIBXXF86VM
	bool "libXxf86vm"
	select BR2_PACKAGE_XLIB_LIBX11
	select BR2_PACKAGE_XLIB_LIBXEXT
	select BR2_PACKAGE_XPROTO_XF86VIDMODEPROTO
        select BR2_PACKAGE_XUTIL_UTIL_MACROS
	help
	  X.Org Xxf86vm library
```

## package/x11r7/xlib_libfontenc/Config.in
```kconfig
config BR2_PACKAGE_XLIB_LIBFONTENC
	bool "libfontenc"
        select BR2_PACKAGE_XUTIL_UTIL_MACROS
	select BR2_PACKAGE_XPROTO_XPROTO
        select BR2_PACKAGE_ZLIB
	help
	  X.Org fontenc library
```

## package/x11r7/xlib_libpciaccess/Config.in
```kconfig
config BR2_PACKAGE_XLIB_LIBPCIACCESS
	bool "libpciaccess"
	depends on BR2_LARGEFILE
        select BR2_PACKAGE_XUTIL_UTIL_MACROS
        select BR2_PACKAGE_ZLIB
	help
	  X.Org libpciaccess

comment "libpciaccess requires a toolchain with LARGEFILE support"
	depends on !BR2_LARGEFILE
```

## package/x11r7/xlib_libxkbfile/Config.in
```kconfig
config BR2_PACKAGE_XLIB_LIBXKBFILE
	bool "libxkbfile"
	select BR2_PACKAGE_XLIB_LIBX11
	select BR2_PACKAGE_XPROTO_KBPROTO
        select BR2_PACKAGE_XUTIL_UTIL_MACROS
	help
	  X.Org xkbfile library
```

## package/x11r7/xlib_xtrans/Config.in
```kconfig
config BR2_PACKAGE_XLIB_XTRANS
	bool "xtrans"
        select BR2_PACKAGE_XUTIL_UTIL_MACROS
	help
	  X.Org xtrans library
```

## package/x11r7/xproto_xf86miscproto/Config.in
```kconfig
config BR2_PACKAGE_XPROTO_XF86MISCPROTO
	bool "xf86miscproto"
	help
          XF86Misc extension headers
```

## package/x11r7/xserver_xorg-server/Config.in
```kconfig
config BR2_PACKAGE_XSERVER_XORG_SERVER
	bool "xorg-server"
	select BR2_PACKAGE_XUTIL_UTIL_MACROS
        select BR2_PACKAGE_XFONT_FONT_UTIL
	select BR2_PACKAGE_XPROTO_FONTSPROTO
	select BR2_PACKAGE_XPROTO_RANDRPROTO
	select BR2_PACKAGE_XPROTO_RECORDPROTO
	select BR2_PACKAGE_XPROTO_RENDERPROTO
	select BR2_PACKAGE_XPROTO_SCRNSAVERPROTO
	select BR2_PACKAGE_XPROTO_VIDEOPROTO
	select BR2_PACKAGE_XPROTO_INPUTPROTO
	select BR2_PACKAGE_XPROTO_XF86DGAPROTO
	select BR2_PACKAGE_XPROTO_XF86DRIPROTO if BR2_PACKAGE_MESA3D
	select BR2_PACKAGE_XPROTO_XF86MISCPROTO
	select BR2_PACKAGE_XPROTO_GLPROTO
	select BR2_PACKAGE_XLIB_LIBPCIACCESS if BR2_PACKAGE_XSERVER_xorg
	select BR2_PACKAGE_XLIB_LIBX11
	select BR2_PACKAGE_XLIB_LIBXFONT
	select BR2_PACKAGE_XLIB_LIBXKBFILE
        select BR2_PACKAGE_XLIB_LIBXINERAMA
	select BR2_PACKAGE_LIBDRM if BR2_PACKAGE_XSERVER_xorg
	select BR2_PACKAGE_MESA3D
	select BR2_PACKAGE_OPENSSL
	select BR2_PACKAGE_FREETYPE
	select BR2_PACKAGE_PIXMAN
        select BR2_PACKAGE_UDEV
	depends on !BR2_avr32
	help
	  xorg-server 1.7.5
	  No description available

comment "xorg-xserver is BROKEN on AVR32"
	depends on BR2_avr32

config BR2_PACKAGE_XSERVER_XORG_SERVER_NULL_CURSOR
    bool "Null root cursor"
    depends on BR2_PACKAGE_XSERVER_XORG_SERVER
    help
        Don't display root cursor.

config BR2_PACKAGE_XSERVER_XORG_SERVER_AIGLX
    bool "Enable AIGLX Extension"
    depends on BR2_PACKAGE_XSERVER_XORG_SERVER
    help
        Enable/Use AIGLX extension.
```
