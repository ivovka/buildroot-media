## package/libnfs/Config.in
```kconfig
config BR2_PACKAGE_LIBNFS
        bool "libnfs"
        select BR2_PACKAGE_RPCBIND
        help
          LIBNFS is a client library for accessing NFS shares over a network

          https://github.com/sahlberg/libnfs
```

## package/libplist/Config.in
```kconfig
config BR2_PACKAGE_LIBPLIST
        bool "libplist"
        select BR2_PACKAGE_LIBXML2
        select BR2_PACKAGE_LIBGLIB2
        help
          libplist is a library for manipulating Apple Binary and XML Property Lists

          http://matt.colyer.name/projects/iphone-linux/
```

## package/libssh/Config.in
```kconfig
config BR2_PACKAGE_LIBSSH
        bool "libssh"
        select BR2_PACKAGE_ZLIB
        select BR2_PACKAGE_LIBGCRYPT
        help
            A working SSH implementation by means of a library
            http://www.libssh.org/
```

## package/libtirpc/Config.in
```kconfig
config BR2_PACKAGE_LIBTIRPC
        bool "libtirpc"
        select BR2_PACKAGE_LIBGSSGLUE
        help
          Libtirpc is a port of Suns Transport-Independent RPC library to Linux.
          It's being developed by the Bull GNU/Linux NFSv4 project.

          https://sourceforge.net/projects/libtirpc/
```

## package/libxml2/Config.in
```kconfig
config BR2_PACKAGE_LIBXML2
	bool "libxml2"
	select BR2_PACKAGE_ZLIB
	help
	  XML C Parser

	  http://xmlsoft.org/
```

## package/multimedia/Config.in
```kconfig
menu "Audio and video libraries and applications"
source "package/multimedia/alsa-lib/Config.in"
source "package/multimedia/alsa-utils/Config.in"
source "package/multimedia/aumix/Config.in"
source "package/multimedia/faad2/Config.in"
source "package/multimedia/flac/Config.in"
source "package/multimedia/ffmpeg/Config.in"
source "package/multimedia/gstreamer/Config.in"
source "package/multimedia/gst-ffmpeg/Config.in"
source "package/multimedia/gst-dsp/Config.in"
source "package/multimedia/gst-omapfb/Config.in"
source "package/multimedia/gst-plugins-base/Config.in"
source "package/multimedia/gst-plugins-good/Config.in"
source "package/multimedia/gst-plugins-bad/Config.in"
source "package/multimedia/gst-plugins-ugly/Config.in"
source "package/multimedia/lame/Config.in"
source "package/multimedia/libaacs/Config.in"
source "package/multimedia/libao/Config.in"
source "package/multimedia/libass/Config.in"
source "package/multimedia/libbluray/Config.in"
source "package/multimedia/libcdaudio/Config.in"
source "package/multimedia/libcdio/Config.in"
source "package/multimedia/libcue/Config.in"
source "package/multimedia/libcuefile/Config.in"
source "package/multimedia/libdvdread/Config.in"
source "package/multimedia/libdvdnav/Config.in"
source "package/multimedia/libid3tag/Config.in"
source "package/multimedia/libmad/Config.in"
source "package/multimedia/libmms/Config.in"
source "package/multimedia/libmodplug/Config.in"
source "package/multimedia/libmpd/Config.in"
source "package/multimedia/libmpeg2/Config.in"
source "package/multimedia/libogg/Config.in"
source "package/multimedia/libreplaygain/Config.in"
source "package/multimedia/libsamplerate/Config.in"
source "package/multimedia/libsndfile/Config.in"
source "package/multimedia/libtheora/Config.in"
source "package/multimedia/libvdpau/Config.in"
source "package/multimedia/libvorbis/Config.in"
source "package/multimedia/live555/Config.in"
source "package/multimedia/madplay/Config.in"
source "package/multimedia/mpd/Config.in"
source "package/multimedia/mpg123/Config.in"
source "package/multimedia/mplayer/Config.in"
source "package/multimedia/musepack/Config.in"
source "package/multimedia/python-mad/Config.in"
source "package/multimedia/rtmpdump/Config.in"
source "package/multimedia/scan-s2/Config.in"
source "package/multimedia/speex/Config.in"
source "package/multimedia/swfdec/Config.in"
source "package/multimedia/szap-s2/Config.in"
source "package/multimedia/tidsp-binaries/Config.in"
source "package/multimedia/taglib/Config.in"
source "package/multimedia/tremor/Config.in"
source "package/multimedia/v4l-utils/Config.in"
source "package/multimedia/vdr/Config.in"
source "package/multimedia/vorbis-tools/Config.in"
source "package/multimedia/wavpack/Config.in"
source "package/multimedia/xbmc/Config.in"
source "package/multimedia/xbmc-addon-xvdr/Config.in"
endmenu
```

## package/multimedia/lame/Config.in
```kconfig
config BR2_PACKAGE_LAME
	bool "lame"
	help
	  LAME is a high quality MPEG Audio Layer III (MP3) encoder.

	  http://lame.sourceforge.net/

config BR2_PACKAGE_LAME_LIBSNDFILE
        bool "Build lame with libsndfile support"
        depends on BR2_PACKAGE_LAME
        select BR2_PACKAGE_LIBSNDFILE
```

## package/multimedia/libaacs/Config.in
```kconfig
config BR2_PACKAGE_LIBAACS
        bool "libaacs"
        select BR2_PACKAGE_LIBGCRYPT
        help
          a research project to implement the
          Advanced Access Content System specification.

          http://www.videolan.org/developers/libaacs.html
```

## package/multimedia/libass/Config.in
```kconfig
config BR2_PACKAGE_LIBASS
        bool "libass"
        select BR2_PACKAGE_FREETYPE
        select BR2_PACKAGE_FONTCONFIG
        select BR2_PACKAGE_ENCA
        select BR2_PACKAGE_FRIBIDI
        help
            a portable subtitle renderer for the ASS/SSA (Advanced Substation Alpha/Substation Alpha) subtitle format.
            http://code.google.com/p/libass/
```

## package/multimedia/libbluray/Config.in
```kconfig
config BR2_PACKAGE_LIBBLURAY
        bool "libbluray"
        select BR2_PACKAGE_LIBXML2
        select BR2_PACKAGE_LIBAACS
        help
            A Blu-Ray Discs playback library.
            http://www.videolan.org/developers/libbluray.html
```

## package/multimedia/libcdio/Config.in
```kconfig
config BR2_PACKAGE_LIBCDIO
        bool "libcdio"
        select BR2_PACKAGE_LIBICONV if !BR2_ENABLE_LOCALE
        help
            A CD-ROM reading and control library.
            http://www.gnu.org/software/libcdio/
```

## package/multimedia/libmodplug/Config.in
```kconfig
config BR2_PACKAGE_LIBMODPLUG
        bool "libmodplug"
        help
            renders mod music files as raw audio data, for playing or conversion.
            http://modplug-xmms.sourceforge.net/
```

## package/multimedia/libmpeg2/Config.in
```kconfig
config BR2_PACKAGE_LIBMPEG2
	bool "libmpeg2"
	help
	  MPEG1/MPEG2 video decoder library

	  http://libmpeg2.sourceforge.net/

config BR2_PACKAGE_LIBMPEG2_SDL
        bool "mpeg2 sdl support"
        depends on BR2_PACKAGE_LIBMPEG2
        select BR2_PACKAGE_SDL
        help
            Build with SDL support.

config BR2_PACKAGE_LIBMPEG2_BINS
	bool "mpeg2 binaries"
	depends on BR2_PACKAGE_LIBMPEG2
	help
	  Install mpeg2dec, corrupt_mpeg2 and extract_mpeg2 programs as
	  well.
```

## package/multimedia/libsamplerate/Config.in
```kconfig
config BR2_PACKAGE_LIBSAMPLERATE
	bool "libsamplerate"
	help
	  Secret Rabbit Code (aka libsamplerate) is a Sample Rate
	  Converter for audio. One example of where such a thing would
	  be useful is converting audio from the CD sample rate of
	  44.1kHz to the 48kHz sample rate used by DAT players.

	  http://www.mega-nerd.com/SRC/

config BR2_PACKAGE_LIBSAMPLERATE_LIBSNDFILE
        bool "libsndfile support in libsamplerate"
        depends on BR2_PACKAGE_LIBSAMPLERATE
        select BR2_PACKAGE_LIBSNDFILE
        help
            Configure libsamplerate with --enable-sndfile
```

## package/multimedia/libvdpau/Config.in
```kconfig
config BR2_PACKAGE_LIBVDPAU
	bool "libvdpau"
        select BR2_PACKAGE_XLIB_LIBX11
	help
          VDPAU is the Video Decode and Presentation API for UNIX.
          It provides an interface to video decode acceleration and
          presentation hardware present in modern GPUs.

	  http://freedesktop.org/wiki/Software/VDPAU
```

## package/multimedia/scan-s2/Config.in
```kconfig
config BR2_PACKAGE_SCAN_S2
        bool "scan-s2"
        help
            DVB scan utility using S2API

            http://mercurial.intuxication.org/hg/scan-s2/
```

## package/multimedia/swh-plugins/Config.in
```kconfig
config BR2_PACKAGE_SWH_PLUGINS
	bool "swh-plugins"
	depends on BR2_PACKAGE_ALSA_LIB
        select BR2_PACKAGE_FFTW
	help
	  LADSPA Plugins

	  http://plugin.org.uk
```

## package/multimedia/szap-s2/Config.in
```kconfig
config BR2_PACKAGE_SZAP_S2
        bool "szap-s2"
        help
            DVB-S(S2) szap-s2 utility for Linux

            http://mercurial.intuxication.org/hg/szap-s2/
```

## package/multimedia/v4l-utils/Config.in
```kconfig
config BR2_PACKAGE_V4L_UTILS
	bool "v4l-utils"
	help
          Linux V4L2 and DVB API utilities and v4l libraries (libv4l).

          http://linuxtv.org/
```

## package/multimedia/vdr/Config.in
```kconfig
config BR2_PACKAGE_VDR
        bool "vdr"
        select BR2_PACKAGE_LIBCAP
        select BR2_PACKAGE_JPEG_LIBRARY
        select BR2_PACKAGE_FONTCONFIG
        select BR2_PACKAGE_FREETYPE
        help
            The Video Disk Recorder

            http://www.tvdr.de

if BR2_PACKAGE_VDR
menu "VDR plugins selection"
config BR2_PACKAGE_VDR_SC
        bool "vdr-sc"
        default n
        help
            VDR softcam plugin

config BR2_PACKAGE_VDR_XVDR
        bool "vdr-xvdr"
        default n
        help
            xvdr plugin

config BR2_PACKAGE_VDR_VNSI
	bool "vdr-vnsi"
	default n
	help
	    vnsi plugin from xbmc

config BR2_PACKAGE_VDR_IPTV
        bool "vdr-iptv"
        default n
        help
            iptv plugin
config BR2_PACKAGE_VDR_XINELIBOUTPUT
        bool "vdr-xineliboutput"
        select BR2_PACKAGE_XINE_LIB
        default n
        help
            xineliboutput plugin
endmenu
endif
```

## package/multimedia/xbmc-addon-xvdr/Config.in
```kconfig
config BR2_PACKAGE_XBMC_ADDON_XVDR
	bool "xbmc-addon-xvdr"
	select BR2_PACKAGE_XBMC
	help
	    Standalone XVDR addon for XBMC

	    https://github.com/pipelka/xbmc-addon-xvdr
```

## package/multimedia/xbmc/Config.in
```kconfig
config BR2_PACKAGE_XBMC
        bool "xbmc"
        select BR2_PACKAGE_BOOST
        select BR2_PACKAGE_PYTHON
        select BR2_PACKAGE_ZLIB
        select BR2_PACKAGE_BZIP2
        select BR2_PACKAGE_LZO
        select BR2_PACKAGE_PCRE
        select BR2_PACKAGE_ALSA_LIB
        select BR2_PACKAGE_LIBASS
        select BR2_PACKAGE_ENCA
        select BR2_PACKAGE_CURL
        select BR2_PACKAGE_LIBSSH
        select BR2_PACKAGE_RTMPDUMP
        select BR2_PACKAGE_DBUS
        select BR2_PACKAGE_XLIB_LIBXT
        select BR2_PACKAGE_XLIB_LIBXTST
        select BR2_PACKAGE_XLIB_LIBXMU
        select BR2_PACKAGE_XLIB_LIBXRANDR
        select BR2_PACKAGE_MESA3D
        select BR2_PACKAGE_GLEW
        select BR2_PACKAGE_FONTCONFIG
        select BR2_PACKAGE_FRIBIDI
        select BR2_PACKAGE_JPEG_LIBRARY
        select BR2_PACKAGE_LIBPNG
        select BR2_PACKAGE_TIFF
        select BR2_PACKAGE_FREETYPE
        select BR2_PACKAGE_JASPER
        select BR2_PACKAGE_LIBMAD
        select BR2_PACKAGE_LIBSAMPLERATE
        select BR2_PACKAGE_LIBOGG
        select BR2_PACKAGE_LIBVORBIS
        select BR2_PACKAGE_LIBCDIO
        select BR2_PACKAGE_LIBMODPLUG
        select BR2_PACKAGE_FAAD2
        select BR2_PACKAGE_FLAC
        select BR2_PACKAGE_WAVPACK
        select BR2_PACKAGE_LAME
        select BR2_PACKAGE_LIBMPEG2
        select BR2_PACKAGE_LIBBLURAY
        select BR2_PACKAGE_SDL
	select BR2_PACKAGE_SDL_X11
        select BR2_PACKAGE_SDL_MIXER
        select BR2_PACKAGE_SDL_IMAGE
        select BR2_PACKAGE_SQLITE
        select BR2_PACKAGE_MYSQL
        select BR2_PACKAGE_SAMBA
        select BR2_PACKAGE_AVAHI
        select BR2_PACKAGE_LIBMICROHTTPD
        select BR2_PACKAGE_LIBVDPAU
        select BR2_PACKAGE_YAJL
	select BR2_PACKAGE_TINYXML
	select BR2_PACKAGE_TAGLIB
    help
      XBMC Media Center (which was formerly named Xbox Media Center) is a free and open source
      cross-platform media player and home entertainment system software with a 10-foot user
      interface designed for the living-room TV.
      Its graphical user interface allows the user to easily manage video, photos, podcasts,
      and music from a computer, optical disk, local network, and the internet using
      a remote control.

      http://www.xbmc.org
```

## package/multimedia/xine-lib/Config.in
```kconfig
config BR2_PACKAGE_XINE_LIB
	bool "xine-lib"
        select BR2_PACKAGE_FFMPEG
        select BR2_PACKAGE_XLIB_LIBXV
        select BR2_PACKAGE_ALSA_LIB
        select BR2_PACKAGE_XLIB_LIBICE
        select BR2_PACKAGE_XLIB_LIBXEXT
        select BR2_PACKAGE_MESA3D
        select BR2_PACKAGE_LIBVDPAU
        select BR2_PACKAGE_LIBBLURAY
        select BR2_PACKAGE_FLAC
        select BR2_PACKAGE_LIBMAD
        select BR2_PACKAGE_LIBMODPLUG
        select BR2_PACKAGE_LIBVORBIS
	help
          xine is a free multimedia player. It plays back CDs, DVDs, and VCDs. It also decodes multimedia files
          like AVI, MOV, WMV, and MP3 from local disk drives, and displays multimedia streamed over the Internet.

	  http://www.xine-project.org/
```

## package/mysql/Config.in
```kconfig
config BR2_PACKAGE_MYSQL
	bool "MySQL client"
	depends on BR2_INSTALL_LIBSTDCPP
	select BR2_PACKAGE_NCURSES
	select BR2_PACKAGE_READLINE
	help
	  MySQL client

comment "Mysql client requires a toolchain with C++ support enabled"
	depends on !BR2_INSTALL_LIBSTDCPP
```

## package/nettle/Config.in
```kconfig
config BR2_PACKAGE_NETTLE
        bool "nettle"
        select BR2_PACKAGE_GMP
        help
          Nettle is a cryptographic library that is designed to fit
          easily in more or less any context: In crypto toolkits for
          object-oriented languages (C++, Python, Pike, ...), in
          applications like LSH or GNUPG, or even in kernel space.
          In most contexts, you need more than the basic
          cryptographic algorithms, you also need some way to keep
          track of available algorithms, their properties and variants.
          You often have some algorithm selection process, often
          dictated by a protocol you want to implement.

          http://www.lysator.liu.se/~nisse/nettle
```
